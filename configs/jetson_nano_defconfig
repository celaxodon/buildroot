## configs/jetson_nano_defconfig
```kconfig
BR2_aarch64=y
BR2_cortex_a57=y
BR2_TOOLCHAIN_EXTERNAL=y
BR2_TOOLCHAIN_EXTERNAL_CUSTOM=y
BR2_TOOLCHAIN_EXTERNAL_DOWNLOAD=y
BR2_TOOLCHAIN_EXTERNAL_URL="http://releases.linaro.org/components/toolchain/binaries/7.3-2018.05/aarch64-linux-gnu/gcc-linaro-7.3.1-2018.05-x86_64_aarch64-linux-gnu.tar.xz"
BR2_TOOLCHAIN_EXTERNAL_CUSTOM_PREFIX="$(ARCH)-linux-gnu"
BR2_TOOLCHAIN_EXTERNAL_GCC_7=y
BR2_TOOLCHAIN_EXTERNAL_HEADERS_4_10=y
BR2_TOOLCHAIN_EXTERNAL_CUSTOM_GLIBC=y
BR2_TOOLCHAIN_EXTERNAL_CXX=y
BR2_ROOTFS_DEVICE_CREATION_DYNAMIC_MDEV=y
BR2_GENERATE_LOCALE="en_US"
BR2_ROOTFS_POST_IMAGE_SCRIPT="board/nvidia/jetson_nano/post-image.sh"
BR2_ROOTFS_POST_SCRIPT_ARGS="-c board/nvidia/jetson_nano/genimage.cfg"
BR2_LINUX_KERNEL=y
BR2_LINUX_KERNEL_CUSTOM_GIT=y
BR2_LINUX_KERNEL_CUSTOM_REPO_URL="git://nv-tegra.nvidia.com/linux-4.9.git"
BR2_LINUX_KERNEL_CUSTOM_REPO_VERSION="tegra-l4t-r32.4.2"
BR2_LINUX_KERNEL_DEFCONFIG="tegra"
BR2_LINUX_KERNEL_DTS_SUPPORT=y
BR2_LINUX_KERNEL_INTREE_DTS_NAME="tegra210-p3448-0000-p3449-0000-b00"
BR2_LINUX_KERNEL_INSTALL_TARGET=y
BR2_LINUX_KERNEL_NEEDS_HOST_OPENSSL=y
BR2_LINUX_KERNEL_EXT_LINUX_NVIDIA=y
BR2_PACKAGE_HARDWARE_NVIDIA=y
BR2_PACKAGE_PLATFORM_T210_COMMON=y
BR2_PACKAGE_PLATFORM_T210_JETSON=y
BR2_PACKAGE_PLATFORM_T210_PORG=y
BR2_PACKAGE_PLATFORM_TEGRA_COMMON=y
BR2_PACKAGE_SOC_T210=y
BR2_PACKAGE_SOC_TEGRA=y
BR2_PACKAGE_DROPBEAR=y
BR2_TARGET_ROOTFS_EXT2=y
BR2_TARGET_ROOTFS_EXT2_4=y
BR2_TARGET_ROOTFS_EXT2_SIZE="125M"
BR2_TARGET_ROOTFS_EXT2_MKFS_OPTIONS=""
BR2_TARGET_UBOOT=y
BR2_TARGET_UBOOT_BUILD_SYSTEM_KCONFIG=y
BR2_TARGET_UBOOT_CUSTOM_GIT=y
BR2_TARGET_UBOOT_CUSTOM_REPO_URL="git://nv-tegra.nvidia.com/3rdparty/u-boot.git"
BR2_TARGET_UBOOT_CUSTOM_REPO_VERSION="tegra-l4t-r32.4.2"
BR2_TARGET_UBOOT_BOARD_DEFCONFIG="p3450-porg"
BR2_TARGET_UBOOT_NEEDS_DTC=y
BR2_TARGET_UBOOT_FORMAT_DTB_BIN=y
BR2_TARGET_UBOOT_FORMAT_CUSTOM=y
BR2_TARGET_UBOOT_FORMAT_CUSTOM_NAME="u-boot.dtb"
BR2_PACKAGE_HOST_GENIMAGE=y
BR2_PACKAGE_HOST_GPTFDISK=y
BR2_PACKAGE_HOST_MKPASSWD=y
BR2_PACKAGE_TEGRA210=y
```

## configs/p3450_defconfig
```kconfig
BR2_aarch64=y
BR2_cortex_a57=y
BR2_TOOLCHAIN_EXTERNAL=y
BR2_TOOLCHAIN_EXTERNAL_LINARO_AARCH64=y
BR2_ROOTFS_DEVICE_CREATION_DYNAMIC_MDEV=y
# BR2_TARGET_ENABLE_ROOT_LOGIN is not set
BR2_GENERATE_LOCALE="en_US"
BR2_LINUX_KERNEL=y
BR2_LINUX_KERNEL_CUSTOM_GIT=y
BR2_LINUX_KERNEL_CUSTOM_REPO_URL="git://nv-tegra.nvidia.com/linux-4.9.git"
BR2_LINUX_KERNEL_CUSTOM_REPO_VERSION="tegra-l4t-r32.4.2"
BR2_LINUX_KERNEL_DEFCONFIG="tegra"
BR2_LINUX_KERNEL_DTS_SUPPORT=y
BR2_LINUX_KERNEL_INTREE_DTS_NAME="tegra210-p3448-0000-p3449-0000-a00"
BR2_LINUX_KERNEL_DTB_OVERLAY_SUPPORT=y
BR2_LINUX_KERNEL_NEEDS_HOST_OPENSSL=y
BR2_LINUX_KERNEL_EXT_LINUX_NVIDIA=y
BR2_PACKAGE_DROPBEAR=y
BR2_TARGET_ROOTFS_EXT2=y
BR2_TARGET_ROOTFS_EXT2_4=y
BR2_TARGET_ROOTFS_EXT2_SIZE="120M"
BR2_PACKAGE_HOST_MKPASSWD=y
```

## package/hardware-nvidia/Config.in
```kconfig
source "package/hardware-nvidia/platform-t210-common/Config.in"
source "package/hardware-nvidia/platform-t210-jetson/Config.in"
source "package/hardware-nvidia/platform-t210-porg/Config.in"
source "package/hardware-nvidia/platform-tegra-common/Config.in"
source "package/hardware-nvidia/soc-t210/Config.in"
source "package/hardware-nvidia/soc-tegra/Config.in"

# Unimplemented parts of the full DTS tree:
# config BR2_PACKAGE_HARDWARE_NVIDIA_PLATFORM_T18X_COMMON
# config BR2_PACKAGE_HARDWARE_NVIDIA_PLATFORM_T18X_QUILL
# config BR2_PACKAGE_HARDWARE_NVIDIA_PLATFORM_T19X_COMMON
# config BR2_PACKAGE_HARDWARE_NVIDIA_PLATFORM_T19X_STARDUST_BCT
# config BR2_PACKAGE_HARDWARE_NVIDIA_SOC_T18X
# config BR2_PACKAGE_HARDWARE_NVIDIA_SOC_T19X
```

## package/hardware-nvidia/platform-t210-common/Config.in
```kconfig
config BR2_PACKAGE_PLATFORM_T210_COMMON
	bool
	depends on BR2_LINUX_KERNEL
	help
	  NVIDIA T210 Common hardware drivers

	  https://developer.nvidia.com/embedded/linux-tegra
```

## package/hardware-nvidia/platform-t210-jetson/Config.in
```kconfig
config BR2_PACKAGE_PLATFORM_T210_JETSON
	bool
	depends on BR2_LINUX_KERNEL
	help
	  NVIDIA T210 Jetson Device Tree Source

	  https://developer.nvidia.com/embedded/linux-tegra
```

## package/hardware-nvidia/platform-t210-porg/Config.in
```kconfig
config BR2_PACKAGE_PLATFORM_T210_PORG
	bool
	depends on BR2_LINUX_KERNEL
	help
	  NVIDIA T210 Porg Device Tree Source

	  https://developer.nvidia.com/embedded/linux-tegra
```

## package/hardware-nvidia/platform-tegra-common/Config.in
```kconfig
config BR2_PACKAGE_PLATFORM_TEGRA_COMMON
	bool
	depends on BR2_LINUX_KERNEL
	help
	  NVIDIA Tegra Common Device Tree Source

	  https://developer.nvidia.com/embedded/linux-tegra
```

## package/hardware-nvidia/soc-t18x/Config.in
```kconfig
config BR2_PACKAGE_SOC_T18X
    bool "SoC T18X Device Tree Source"
    depends on BR2_LINUX_KERNEL_EXT_LINUX_NVIDIA
    help
        NVIDIA T18X Jetson hardware drivers

        nv-tegra.nvidia.com/hardware/nvidia/soc/t18x.git
```

## package/hardware-nvidia/soc-t19x/Config.in
```kconfig
config BR2_PACKAGE_SOC_T19X
    bool "SoC T19x Device Tree Source"
    depends on BR2_LINUX_KERNEL_EXT_LINUX_NVIDIA
    help
        NVIDIA T19x Jetson hardware drivers

        nv-tegra.nvidia.com/hardware/nvidia/soc/t19x.git
```

## package/hardware-nvidia/soc-t210/Config.in
```kconfig
config BR2_PACKAGE_SOC_T210
	bool
	depends on BR2_LINUX_KERNEL
	help
	  NVIDIA T210 Jetson hardware drivers

	  https://developer.nvidia.com/embedded/linux-tegra
```

## package/hardware-nvidia/soc-tegra/Config.in
```kconfig
config BR2_PACKAGE_SOC_TEGRA
	bool
	depends on BR2_LINUX_KERNEL
	help
	  NVIDIA Tegra Jetson hardware drivers

	  https://developer.nvidia.com/embedded/linux-tegra
```

## package/linux-nvgpu/Config.in
```kconfig
config BR2_PACKAGE_LINUX_NVGPU
	bool
	depends on BR2_LINUX_KERNEL
	help
	  The download helper for NVIDIA NVGPU Tegra driver kernel
	  patches.

	  https://developer.nvidia.com/embedded/linux-tegra
```

## package/linux-nvidia/Config.in
```kconfig
config BR2_PACKAGE_LINUX_NVIDIA
	bool
	depends on BR2_LINUX_KERNEL
	help
	  NVIDIA Linux source code for Tegra

	  https://developer.nvidia.com/embedded/linux-tegra
```

## package/tegra210-linux/Config.in
```kconfig
config BR2_PACKAGE_TEGRA210_LINUX
	bool "Tegra T210 Board Support Package"
	depends on BR2_PACKAGE_LINUX_NVIDIA
	help
	  NVIDIA Tegra210 board support package.
	  Includes binaries and tools required for the flashing and
	  booting process.

	  https://developer.nvidia.com/embedded/linux-tegra
```
